// SPDX-License-Identifier: BSD-3-Clause
/*
 * Copyright (c) 2021, Dominik Kobinski <Dominduchami@outlook.com>
 * Copyright (c) 2021, Ivaylo Ivanov <ivo.ivanov@null.net>
 */
/dts-v1/;

#include "qcom-msm8226-nokia-lumia-common.dtsi"

/ {
	model = "Microsoft Lumia 640";
	compatible = "lumia,dempsey","qcom,msm8226";
};
